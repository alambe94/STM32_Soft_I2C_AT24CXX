# file: STM32_Soft_I2C_AT24CXX.ioc
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Mcu.Family=STM32F1
Mcu.Name=STM32F103C(8-B)Tx
Mcu.Package=LQFP48
NVIC.PriorityGroup=NVIC_PRIORITYGROUP_4
PA13.Mode=Serial_Wire
PA13.Signal=SYS_JTMS-SWDIO
PA14.Mode=Serial_Wire
PA14.Signal=SYS_JTCK-SWCLK
PC14-OSC32_IN.Mode=LSE-External-Oscillator
PC14-OSC32_IN.Signal=RCC_OSC32_IN
PC15-OSC32_OUT.Mode=LSE-External-Oscillator
PC15-OSC32_OUT.Signal=RCC_OSC32_OUT
PD0-OSC_IN.Mode=HSE-External-Oscillator
PD0-OSC_IN.Signal=RCC_OSC_IN
PD1-OSC_OUT.Mode=HSE-External-Oscillator
PD1-OSC_OUT.Signal=RCC_OSC_OUT
ProjectManager.HeapSize=0x200
ProjectManager.StackSize=0x400
ProjectManager.TargetToolchain=STM32CubeIDE
RCC.AHBFreq_Value=72000000
RCC.APB1CLKDivider=RCC_HCLK_DIV2
RCC.APB1Freq_Value=36000000
RCC.APB1TimFreq_Value=72000000
RCC.APB2Freq_Value=72000000
RCC.APB2TimFreq_Value=72000000
RCC.HCLKFreq_Value=72000000
RCC.PLLMUL=RCC_PLL_MUL9
RCC.PLLSourceVirtual=RCC_PLLSOURCE_HSE
RCC.SYSCLKFreq_VALUE=72000000
RCC.SYSCLKSource=RCC_SYSCLKSOURCE_PLLCLK
RCC.USBFreq_Value=72000000
board=STM32_Soft_I2C_AT24CXX

// file: Src/main.c
/* USER CODE BEGIN Header */
/**
  ******************************************************************************
  * @file           : main.c
  * @brief          : Main program body
  ******************************************************************************
  * @attention
  *
  * <h2><center>&copy; Copyright (c) 2019 STMicroelectronics.
  * All rights reserved.</center></h2>
  *
  * This software component is licensed by ST under BSD 3-Clause license,
  * the "License"; You may not use this file except in compliance with the
  * License. You may obtain a copy of the License at:
  *                        opensource.org/licenses/BSD-3-Clause
  *
  ******************************************************************************
  */
/* USER CODE END Header */

#include "main.h"
#include "gpio.h"

/* USER CODE BEGIN Includes */
#include "soft_i2c.h"
#include "ssd1306.h"

#include "at24cxx.h"
#include "stdlib.h"

/* USER CODE END Includes */

/* USER CODE BEGIN PD */

Soft_I2C_t Soft_I2C1;

#define SOFT_I2C_SDA_PIN		GPIO_PIN_7
#define SOFT_I2C_SDA_PORT		GPIOB

#define SOFT_I2C_SCL_PIN		GPIO_PIN_6
#define SOFT_I2C_SCL_PORT		GPIOB

/* USER CODE END PD */

/* USER CODE BEGIN PV */
/* Private variables ---------------------------------------------------------*/
	uint8_t write_buffer[256];
	uint8_t compare_buffer[256];
/* USER CODE END PV */

void SystemClock_Config(void);
/* USER CODE BEGIN PFP */
/* Private function prototypes -----------------------------------------------*/

/* USER CODE END PFP */

int main(void)
{

  /* MCU Configuration--------------------------------------------------------*/

  /* Reset of all peripherals, Initializes the Flash interface and the Systick. */
  HAL_Init();

  /* Configure the system clock */
  SystemClock_Config();

  /* Initialize all configured peripherals */
  MX_GPIO_Init();
  /* USER CODE BEGIN 2 */

    Soft_I2C1.GPIO_SCL_Pin = SOFT_I2C_SCL_PIN;
    Soft_I2C1.GPIO_SCL_Port = SOFT_I2C_SCL_PORT;

    Soft_I2C1.GPIO_SDA_Pin = SOFT_I2C_SDA_PIN;
    Soft_I2C1.GPIO_SDA_Port = SOFT_I2C_SDA_PORT;

    Soft_I2C_Init(&Soft_I2C1);

    ssd1306_Init();
	char temp[5];

	/*********************scan for i2c devices****************************/
	for (uint16_t i = 0; i < 128; i++)
	{
		itoa(i<<1 ,temp, 16);//int string base 16 (hex)

		if(Soft_I2C_Scan(&Soft_I2C1, i<<1)==SOFT_I2C_OK)
		{
			ssd1306_SetCursor(0, 30);
			ssd1306_WriteString("At:", Font_11x18, White);
			ssd1306_WriteString("0x", Font_11x18, White);
			ssd1306_WriteString(temp, Font_11x18, White);
			ssd1306_UpdateScreen();
			HAL_Delay(10);
		}
		else
		{
			ssd1306_SetCursor(0, 0);
			ssd1306_WriteString("NO:", Font_11x18, White);
			ssd1306_WriteString("0x", Font_11x18, White);
			ssd1306_WriteString(temp, Font_11x18, White);
			ssd1306_UpdateScreen();
			HAL_Delay(10);
		}
	}
	/*********************scan for i2c devices****************************/

	/*********************fill write_buffer****************************/
	for (uint16_t i = 0; i <= 255; i++)
	{
		write_buffer[i]=i;
	}

	AT24CXX_Write_Buffer(0x00,write_buffer,256);

	AT24CXX_Read_Buffer(0x00,compare_buffer,256);

	ssd1306_Fill(Black);

	/*********************compare write_buffer****************************/
	for(uint16_t i=0;i<=255;i++)
	{
		itoa(i, temp, 10);//int string base 10
		if(write_buffer[i]!=compare_buffer[i])
		{
			ssd1306_SetCursor(0, 30);
			ssd1306_WriteString("Error:", Font_11x18, White);
			ssd1306_WriteString(temp, Font_11x18, White);
			ssd1306_UpdateScreen();
		}
		else
		{
			ssd1306_SetCursor(0, 30);
			ssd1306_WriteString("OK:", Font_11x18, White);
			ssd1306_WriteString(temp, Font_11x18, White);
			ssd1306_UpdateScreen();
		}

	}

  /* USER CODE END 2 */

  /* Infinite loop */
	while (1)
	{

	}
}

void SystemClock_Config(void)
{
  RCC_OscInitTypeDef RCC_OscInitStruct = {0};
  RCC_ClkInitTypeDef RCC_ClkInitStruct = {0};

  /** Initializes the CPU, AHB and APB busses clocks
  */
  RCC_OscInitStruct.OscillatorType = RCC_OSCILLATORTYPE_HSE;
  RCC_OscInitStruct.HSEState = RCC_HSE_ON;
  RCC_OscInitStruct.HSEPredivValue = RCC_HSE_PREDIV_DIV1;
  RCC_OscInitStruct.HSIState = RCC_HSI_ON;
  RCC_OscInitStruct.PLL.PLLState = RCC_PLL_ON;
  RCC_OscInitStruct.PLL.PLLSource = RCC_PLLSOURCE_HSE;
  RCC_OscInitStruct.PLL.PLLMUL = RCC_PLL_MUL9;
  if (HAL_RCC_OscConfig(&RCC_OscInitStruct) != HAL_OK)
  {
    Error_Handler();
  }
  /** Initializes the CPU, AHB and APB busses clocks
  */
  RCC_ClkInitStruct.ClockType = RCC_CLOCKTYPE_HCLK|RCC_CLOCKTYPE_SYSCLK
                              |RCC_CLOCKTYPE_PCLK1|RCC_CLOCKTYPE_PCLK2;
  RCC_ClkInitStruct.SYSCLKSource = RCC_SYSCLKSOURCE_PLLCLK;
  RCC_ClkInitStruct.AHBCLKDivider = RCC_SYSCLK_DIV1;
  RCC_ClkInitStruct.APB1CLKDivider = RCC_HCLK_DIV2;
  RCC_ClkInitStruct.APB2CLKDivider = RCC_HCLK_DIV1;

  if (HAL_RCC_ClockConfig(&RCC_ClkInitStruct, FLASH_LATENCY_2) != HAL_OK)
  {
    Error_Handler();
  }
}

void Error_Handler(void)
{
	while (1)
	{
	}
}

/************************ (C) COPYRIGHT STMicroelectronics *****END OF FILE****/
